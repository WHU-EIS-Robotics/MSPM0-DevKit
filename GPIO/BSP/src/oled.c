#include "oled.h"
#include "ti_msp_dl_config.h"
#include "math.h"


void OLED_Init()
{
//  ---------------SH1106
//	OLED_WR_Byte(0xAE,OLED_CMD);//--display off
//	OLED_WR_Byte(0x02,OLED_CMD);////设置列地址低四位（00-0F）。（0 0 0 0 A3 A2 A1 A0）
//	OLED_WR_Byte(0x10,OLED_CMD);//设置列地址高四位（10-1F）。（0 0 0 1 A7 A6 A5 A4）
//	OLED_WR_Byte(0x40,OLED_CMD);//指定起始行地址（40-7F），共64行（每行一像素） 
//	OLED_WR_Byte(0xB0,OLED_CMD);///指定起始页地址（B0-B7），共8页（每页8像素）
//	OLED_WR_Byte(0x81,OLED_CMD); //启用对比度数据寄存器。双字节命令。
//	OLED_WR_Byte(0xCF,OLED_CMD);//启用对比度数据寄存器。双字节命令。
//	OLED_WR_Byte(0xA1,OLED_CMD);//A1：正常显示，A0：水平反转显示。当显示数据被写入或读取时，列地址增加1
//	OLED_WR_Byte(0xC8,OLED_CMD);//C0-C7：正常显示，C8-CF：垂直翻转。设置公共输出扫描方向。
//	OLED_WR_Byte(0xA6,OLED_CMD);//A6：关反显，A7：开反显。在不重写显示数据RAM内容的情况下反转显示开/关状态
//	
//	OLED_WR_Byte(0xA8,OLED_CMD);//设置多路复用比率。此命令将默认的64种多路传输模式切换到1到64之间的任意多路传输比率。双字节命令，设置完这条命令后需要写入比率数据
//	OLED_WR_Byte(0x3F,OLED_CMD);//多路定量数据集（00-3F）。3F：64路多路传输比率。
//	OLED_WR_Byte(0xD3,OLED_CMD);//设置显示偏移模式。双字节命令，设置完这条命令后需要写入显示偏移模式数据。
//	OLED_WR_Byte(0x00,OLED_CMD);//偏移量（00-3F）。00：不偏移。
//	
//	OLED_WR_Byte(0xD5,OLED_CMD);//设置显示时钟分频比/振荡器频率。双字节命令，设置完这条命令后需要写入显示时钟分频比/振荡器频率数据。
//	OLED_WR_Byte(0x80,OLED_CMD);//分频比/振荡器频率数据（00-FF）。0x80：分频比为1，振荡器频率为+15%
//	OLED_WR_Byte(0xD9,OLED_CMD);//设置预充电周期的持续时间。间隔以DCLK的个数计。POR是2个DCLKs。双字节命令，设置完这条命令后需要写入预充电周期的持续时间。
//	OLED_WR_Byte(0xF1,OLED_CMD);//周期持续时间（00-FF）。0xF1：预充电周期的持续时间为1个DCLK，掉电周期的持续时间为15个DCLK。
//	OLED_WR_Byte(0xDA,OLED_CMD);//设置公用焊盘硬件配置。此命令用于设置公共信号板配置（顺序或替代）以匹配OLED面板硬件布局。双字节命令，设置完这条命令后需要写入公用焊盘硬件配置。
//	OLED_WR_Byte(0x12,OLED_CMD);//顺序/替代模式设置（02-12）。0x02：顺序模式。0x12：替代模式。
//	OLED_WR_Byte(0xDB,OLED_CMD);//设置VCOM取消选择级别。此命令用于在取消选择阶段设置公共焊盘输出电压电平。双字节命令。
//	OLED_WR_Byte(0x40,OLED_CMD);//VCOM取消选择级别数据（00-FF）。。
//	OLED_WR_Byte(0xA4,OLED_CMD);//关闭/打开整个显示。0xA4：正常显示。0xA5：整个显示。此命令的优先级高于正常/反向显示命令。
//	OLED_WR_Byte(0xA6,OLED_CMD);//
//	OLED_WR_Byte(0xAF,OLED_CMD);//开显示
	
	
	
//  ---------------------------SSD1306	
//	OLED_WR_Byte(0xAE, OLED_CMD); //--display off
//	OLED_WR_Byte(0x00, OLED_CMD); //---set low column address
//	OLED_WR_Byte(0x10, OLED_CMD); //---set high column address
//	OLED_WR_Byte(0x40, OLED_CMD); //--set start line address
//	OLED_WR_Byte(0xB0, OLED_CMD); //--set page address
//	OLED_WR_Byte(0x81, OLED_CMD); // contract control
//	OLED_WR_Byte(0xFF, OLED_CMD); //--128
//	OLED_WR_Byte(0xA1, OLED_CMD); //set segment remap
//	OLED_WR_Byte(0xA6, OLED_CMD); //--normal / reverse
//	OLED_WR_Byte(0xA8, OLED_CMD); //--set multiplex ratio(1 to 64)
//	OLED_WR_Byte(0x3F, OLED_CMD); //--1/32 duty
//	OLED_WR_Byte(0xC8, OLED_CMD); //Com scan direction
//	OLED_WR_Byte(0xD3, OLED_CMD); //-set display offset
//	OLED_WR_Byte(0x00, OLED_CMD); //

//	OLED_WR_Byte(0xD5, OLED_CMD); //set osc division
//	OLED_WR_Byte(0x80, OLED_CMD); //

//	OLED_WR_Byte(0xD8, OLED_CMD); //set area color mode off
//	OLED_WR_Byte(0x05, OLED_CMD); //

//	OLED_WR_Byte(0xD9, OLED_CMD); //Set Pre-Charge Period
//	OLED_WR_Byte(0xF1, OLED_CMD); //

//	OLED_WR_Byte(0xDA, OLED_CMD); //set com pin configuartion
//	OLED_WR_Byte(0x12, OLED_CMD); //

//	OLED_WR_Byte(0xDB, OLED_CMD); //set Vcomh
//	OLED_WR_Byte(0x30, OLED_CMD); //

//	OLED_WR_Byte(0x8D, OLED_CMD); //set charge pump enable
//	OLED_WR_Byte(0x14, OLED_CMD); //

//	OLED_WR_Byte(0xAF, OLED_CMD); //--turn on oled panel
	
	
//  ---------------------------------
//	OLED_WR_Byte(0xAE,OLED_CMD);//--display off
//	OLED_WR_Byte(0x02,OLED_CMD);//---set low column address
//	OLED_WR_Byte(0x10,OLED_CMD);//---set high column address
//	OLED_WR_Byte(0x40,OLED_CMD);//--set start line address  
//	OLED_WR_Byte(0xB0,OLED_CMD);//--set page address
//	OLED_WR_Byte(0x81,OLED_CMD); // contract control
//	OLED_WR_Byte(0xFF,OLED_CMD);//--128   
//	OLED_WR_Byte(0xA1,OLED_CMD);//set segment remap 
//	OLED_WR_Byte(0xA6,OLED_CMD);//--normal / reverse
//	OLED_WR_Byte(0xA8,OLED_CMD);//--set multiplex ratio(1 to 64)
//	OLED_WR_Byte(0x3F,OLED_CMD);//--1/64 duty
//	OLED_WR_Byte(0xAD,OLED_CMD);//set charge pump enable
//	OLED_WR_Byte(0x8B,OLED_CMD);//-0x8B 内供 VCC
//	OLED_WR_Byte(0x33,OLED_CMD);//-0X30---0X33 set VPP 9V
//	OLED_WR_Byte(0xC8,OLED_CMD);//Com scan direction
//	OLED_WR_Byte(0xD3,OLED_CMD);//-set display offset
//	OLED_WR_Byte(0x00,OLED_CMD);//
//	
//	OLED_WR_Byte(0xD5,OLED_CMD);//set osc division
//	OLED_WR_Byte(0x80,OLED_CMD);//
//	
//	OLED_WR_Byte(0xD8,OLED_CMD);//set area color mode off
//	OLED_WR_Byte(0x05,OLED_CMD);//
//	
//	OLED_WR_Byte(0xD9,OLED_CMD);//Set Pre-Charge Period
//	OLED_WR_Byte(0x1F,OLED_CMD);//
//	
//	OLED_WR_Byte(0xDA,OLED_CMD);//set com pin configuartion
//	OLED_WR_Byte(0x12,OLED_CMD);//
//	
//	OLED_WR_Byte(0xDB,OLED_CMD);//set Vcomh
//	OLED_WR_Byte(0x40,OLED_CMD);//
//	
//	
//	OLED_WR_Byte(0xAF,OLED_CMD);//--turn on oled panel


//--------------------------------------------
	OLED_WR_Byte(0xAE,OLED_CMD);//--display off
	OLED_WR_Byte(0x02,OLED_CMD);//---set low column address
	OLED_WR_Byte(0x10,OLED_CMD);//---set high column address
	OLED_WR_Byte(0x40,OLED_CMD);//--set start line address  
	OLED_WR_Byte(0xB0,OLED_CMD);//--set page address
	OLED_WR_Byte(0x81,OLED_CMD);// contract control
	OLED_WR_Byte(0xFF,OLED_CMD);//--128   
	OLED_WR_Byte(0xA1,OLED_CMD);//set segment remap 
	OLED_WR_Byte(0xA6,OLED_CMD);//--normal / reverse
	OLED_WR_Byte(0xA8,OLED_CMD);//--set multiplex ratio(1 to 64)
	OLED_WR_Byte(0x3F,OLED_CMD);//--1/32 duty
	OLED_WR_Byte(0xC8,OLED_CMD);//Com scan direction
	OLED_WR_Byte(0xD3,OLED_CMD);//-set display offset
	OLED_WR_Byte(0x00,OLED_CMD);//
	
	OLED_WR_Byte(0xD5,OLED_CMD);//set osc division
	OLED_WR_Byte(0x80,OLED_CMD);//
	
	OLED_WR_Byte(0xD8,OLED_CMD);//set area color mode off
	OLED_WR_Byte(0x05,OLED_CMD);//
	
	OLED_WR_Byte(0xD9,OLED_CMD);//Set Pre-Charge Period
	OLED_WR_Byte(0xF1,OLED_CMD);//
	
	OLED_WR_Byte(0xDA,OLED_CMD);//set com pin configuartion
	OLED_WR_Byte(0x12,OLED_CMD);//
	
	OLED_WR_Byte(0xDB,OLED_CMD);//set Vcomh
	OLED_WR_Byte(0x30,OLED_CMD);//
	
	OLED_WR_Byte(0x8D,OLED_CMD);//set charge pump enable
	OLED_WR_Byte(0x14,OLED_CMD);//
	
	OLED_WR_Byte(0xAF,OLED_CMD);//--turn on oled panel
}

void OLED_Set_Pos(unsigned char x, unsigned char y)
{
	OLED_WR_Byte(0xb0+y,OLED_CMD);
	OLED_WR_Byte(((x&0xf0)>>4)|0x10,OLED_CMD);
	OLED_WR_Byte((x&0x0f)|0x01,OLED_CMD); 
}


// ---------------------------------------------硬件IIC
#if OLED_I2C_SELECT

void OLED_WR_Byte(uint8_t data,uint8_t cmd)
{
	//DL_I2C_enableStartCondition(I2C0);
	if(cmd)
	{
		DL_I2C_transmitControllerData(I2C0,0X40);
		DL_I2C_transmitControllerData(I2C0,data);
	}
	else
	{
		DL_I2C_transmitControllerData(I2C0,0X00);
		DL_I2C_transmitControllerData(I2C0,data);
	}
	DL_I2C_startControllerTransfer(I2C0,OLED_ADDRESS,DL_I2C_CONTROLLER_DIRECTION_TX,2);
  	while (DL_I2C_getControllerStatus(I2C_0_INST) &DL_I2C_CONTROLLER_STATUS_BUSY_BUS);      //等待发送完成
	while (!(DL_I2C_getControllerStatus(I2C_0_INST) &DL_I2C_CONTROLLER_STATUS_IDLE));		//等待I2C空闲
	delay_cycles(30);
//	DL_I2C_disableStopCondition(I2C0);
}
#else
// ---------------------------------------------模拟IIC
void IIC_Start()
{

	OLED_SCLK_Set() ;
	delay_cycles(2);
	OLED_SDIN_Set();
	delay_cycles(2);
	OLED_SDIN_Clr();
	delay_cycles(2);
	OLED_SCLK_Clr();
	delay_cycles(2);
}

void IIC_Stop()
{

	OLED_SCLK_Clr();
	delay_cycles(2);
	OLED_SDIN_Clr();
	delay_cycles(2);
	OLED_SDIN_Set();
	delay_cycles(2);
	OLED_SCLK_Set();
	delay_cycles(2);
}

void Write_IIC_Byte(unsigned char IIC_Byte)
{
	unsigned char i;
	unsigned char m,da;
	da=IIC_Byte;
	for(i=0;i<8;i++)		
	{
		m=da;
		OLED_SCLK_Clr();
		delay_cycles(2);
		m=m&0x80;
		if(m==0x80)
		{OLED_SDIN_Set();}
		else OLED_SDIN_Clr();
		delay_cycles(2);
		da=da<<1;
		OLED_SCLK_Set();
		delay_cycles(2);
	}
	OLED_SCLK_Clr();
	delay_cycles(2);
	OLED_SCLK_Set() ;
	delay_cycles(2);
}

void OLED_WR_Byte(uint8_t data,uint8_t cmd)
{
	if(cmd)
	{
		IIC_Start();
		Write_IIC_Byte(0x78);			//D/C#=0; R/W#=0
		Write_IIC_Byte(0x40);			//write data
		Write_IIC_Byte(data);
		IIC_Stop();
	}
	else 
	{
		IIC_Start();
		Write_IIC_Byte(0x78);            //Slave address,SA0=0
		Write_IIC_Byte(0x00);			//write command
		Write_IIC_Byte(data); 
		IIC_Stop();
	}
}
#endif



// --------------------------------------OLED打印函数
void OLED_ShowChar(uint8_t x,uint8_t y,uint8_t chr,uint8_t Char_Size)
{      	
	unsigned char c=0,i=0;	
	c = chr - ' ';//得到偏移后的值			
	if(x>Max_Column-1){x=0;y=y+2;}
	if(Char_Size ==16)
	{
		OLED_Set_Pos(x,y);	
		for(i=0;i<8;i++)
		OLED_WR_Byte(F8X16[c*16+i],OLED_DATA);
		OLED_Set_Pos(x,y+1);
		for(i=0;i<8;i++)
		OLED_WR_Byte(F8X16[c*16+i+8],OLED_DATA);
	}
	else 
	{	
		OLED_Set_Pos(x,y);
		for(i=0;i<6;i++)
		OLED_WR_Byte(F6x8[c][i],OLED_DATA);
	}
}

void OLED_ShowString(uint8_t x,uint8_t y,char *chr,uint8_t Char_Size)
{
	unsigned char j=0;
	while (chr[j]!='\0')
	{		
		OLED_ShowChar(x,y,chr[j],Char_Size);
		x+=8;
		if(x>120){x=0;y+=2;}
		j++;
	}
}

// 清除函数，更新显示
void OLED_Clear(void)  
{  
	uint8_t i,n;		    
	for(i=0;i<8;i++)  
	{  
		OLED_WR_Byte (0xb0+i,OLED_CMD);    //设置页地址（0~7）
		OLED_WR_Byte (0x02,OLED_CMD);      //设置显示位置—列低地址
		OLED_WR_Byte (0x10,OLED_CMD);      //设置显示位置—列高地址   
		for(n=0;n<128;n++)
		{
			OLED_WR_Byte(0x00,OLED_DATA);
		} 
	}
}

uint32_t oled_pow(uint8_t m,uint8_t n)
{
    uint32_t result=1;
    while(n--)result*=m;
    return result;
}

void OLED_Showdecimal(uint8_t x,uint8_t y,float num,uint8_t len,uint8_t size2)
{         	
	uint8_t t,temp,len1,temp1;
	float temp2;
	uint8_t enshow=0;
    if(num < 0)
	{
        OLED_ShowChar(x,y,'0'- 3,size2);
		num =fabs(num);
	}
    else
	OLED_ShowChar(x,y,' ',size2);//第一位显示符号
	temp1 = (int)temp;
	temp2 = num - temp1;
	len1 = len - 6;//len1为整数部分位数，若显示数位需要扩展，修改该行
	OLED_ShowChar(x + size2/2*4,y,'0'- 2,size2);//浮点数的第5位显示小数点
	x = x + size2/2;
	for(t=0;t<len1;t++)//整数部分的显示
	{
		temp=(int)((num/oled_pow(10,len1-t-1)))%10;
		if(enshow==0&&t<(len1-1))
		{
			if(temp==0)
			{
				OLED_ShowChar(x+(size2/2)*t,y,' ',size2);
				continue;
			}else enshow=1; 
		 	 
		}
	 	OLED_ShowChar(x+(size2/2)*t,y,temp+'0',size2); 
	}
	OLED_ShowChar(x+(size2/2)*4,y,((int)(temp2*10)%10) + '0',size2); //小数第一位
	OLED_ShowChar(x+(size2/2)*5,y,((int)(temp2*100)%10) + '0',size2); //小数第2位
	OLED_ShowChar(x+(size2/2)*6,y,((int)(temp2*1000)%10) + '0',size2); //小数第3位
	OLED_ShowChar(x+(size2/2)*7,y,((int)(temp2*10000)%10) + '0',size2); //小数第4位
}

void OLED_ShowNumber(uint8_t x,uint8_t y,uint16_t num,uint8_t len,uint8_t size2)
{
	uint8_t t,temp;
	uint8_t enshow=0;
	for(t=0;t<len;t++)
	{
		temp=(num/oled_pow(10,len-t-1))%10;
		if(enshow==0&&t<(len-1))
		{
			if(temp==0)
			{
				OLED_ShowChar(x+(size2/2)*t,y,' ',size2);
				continue;
			}else enshow=1; 
		 	 
		}
	 	OLED_ShowChar(x+(size2/2)*t,y,temp+'0',size2); 
	}
}





// ---------------------------------ASCII
const unsigned char F6x8[][6] =		
{
0x00, 0x00, 0x00, 0x00, 0x00, 0x00,// sp
0x00, 0x00, 0x00, 0x2f, 0x00, 0x00,// !
0x00, 0x00, 0x07, 0x00, 0x07, 0x00,// "
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0x14, 0x14, 0x14, 0x14, 0x14, 0x14,// horiz lines
};

const char F8X16[]=
{
	0x00,0x00,0x00,0x00,0x00,0x00,0x00,0x00,0x00,0x00,0x00,0x00,0x00,0x00,0x00,0x00,// 0
  0x00,0x00,0x00,0xF8,0x00,0x00,0x00,0x00,0x00,0x00,0x00,0x33,0x30,0x00,0x00,0x00,//! 1
  0x00,0x10,0x0C,0x06,0x10,0x0C,0x06,0x00,0x00,0x00,0x00,0x00,0x00,0x00,0x00,0x00,//" 2
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  0x00,0x06,0x01,0x01,0x02,0x02,0x04,0x04,0x00,0x00,0x00,0x00,0x00,0x00,0x00,0x00,//~ 94
};


